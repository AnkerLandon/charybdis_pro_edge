#include "charybdis.dtsi"
#include "split_input_common.dtsi"

/ {
    chosen {
        zmk,kscan = &mock_kscan;
        zephyr,display = &st7789;
    };

    /* Forces the dongle to act as a receiver rather than reading physical switches */
    mock_kscan: kscan_1 {
        compatible = "zmk,kscan-mock";
        columns = <0>;
        rows = <0>;
        events = <0>;
    };
};

/* Enable the trackball input listener (disabled by default in split_input_common.dtsi) */
&trackball_listener {
    status = "okay";
};
