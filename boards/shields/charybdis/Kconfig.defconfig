## boards/shields/charybdis/Kconfig.defconfig
```kconfig
if SHIELD_CHARYBDIS_DONGLE

config ZMK_KEYBOARD_NAME
	default "Charybdis"

config ZMK_SPLIT_ROLE_CENTRAL
	default y

config BT_MAX_CONN
	default 7

config BT_MAX_PAIRED
	default 7

endif

if SHIELD_CHARYBDIS_DONGLE || SHIELD_CHARYBDIS_LEFT || SHIELD_CHARYBDIS_RIGHT

config ZMK_SPLIT
	default y
	
endif
```

## config/west.yml
```yaml
manifest:
  remotes:
    - name: zmkfirmware
      url-base: https://github.com/zmkfirmware
    - name: badjeff
      url-base: https://github.com/badjeff
    - name: carrefinho
      url-base: https://github.com/carrefinho
    - name: te9no
      url-base: https://github.com/te9no
  projects:
    - name: zmk
      remote: zmkfirmware
      revision: v0.3
      import: app/west.yml
    - name: zmk-pmw3610-driver
      remote: badjeff
      revision: zmk-0.3
    - name: prospector-zmk-module
      remote: carrefinho
      revision: main
    - name: zmk-input-processor-keybind
      remote: te9no
      revision: main
  self:
    path: config
```
